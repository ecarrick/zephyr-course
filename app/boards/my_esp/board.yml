## app/boards/my_esp/board.yml
```yaml
board:
  name: my_esp
  full_name: ESP32-C3-DevKitC
  vendor: espressif
  socs:
  - name: esp32c3
```

## app/boards/scratch_esp/board.yml
```yaml
board:
  name: scratch_esp
  full_name: esp32c3 from sctach
  vendor: custom
  socs:
  - name: esp32c3
```

## dts/bindings/our,driver.yaml
```yaml
description: custom driver
compatible: "our,driver"
include: base.yaml

properties:
  gpios:
    type: phandle-array
    required: true
  step:
    type: int
    required: true
```

## twister-out/native_sim_native/host/homework.unit.ring_buf/Kconfig/Kconfig.modules
```kconfig
menu "cmsis_6 (/home/edison/source/iomico-fund/deps/modules/hal/cmsis_6)"
osource "$(ZEPHYR_CMSIS_6_KCONFIG)"
config ZEPHYR_CMSIS_6_MODULE
	bool
	default y
endmenu
menu "hal_espressif (/home/edison/source/iomico-fund/deps/modules/hal/espressif)"
osource "/home/edison/source/iomico-fund/deps/modules/hal/espressif/zephyr/Kconfig"
config ZEPHYR_HAL_ESPRESSIF_MODULE
	bool
	default y

config ZEPHYR_HAL_ESPRESSIF_MODULE_BLOBS
	bool
endmenu
menu "hal_nordic (/home/edison/source/iomico-fund/deps/modules/hal/nordic)"
osource "$(ZEPHYR_HAL_NORDIC_KCONFIG)"
config ZEPHYR_HAL_NORDIC_MODULE
	bool
	default y

config ZEPHYR_HAL_NORDIC_MODULE_BLOBS
	bool
endmenu
menu "hal_nxp (/home/edison/source/iomico-fund/deps/modules/hal/nxp)"
osource "$(ZEPHYR_HAL_NXP_KCONFIG)"
config ZEPHYR_HAL_NXP_MODULE
	bool
	default y

config ZEPHYR_HAL_NXP_MODULE_BLOBS
	bool
endmenu
config ZEPHYR_HAL_STM32_MODULE
	bool
	default y

config ZEPHYR_HAL_STM32_MODULE_BLOBS
	bool
```

## twister-out/native_sim_native/host/homework.unit.ring_buf/Kconfig/arch/Kconfig
```kconfig
# Load Zephyr Arch Kconfig descriptions.
osource "/home/edison/source/iomico-fund/deps/zephyr/arch/rx/Kconfig"
osource "/home/edison/source/iomico-fund/deps/zephyr/arch/x86/Kconfig"
osource "/home/edison/source/iomico-fund/deps/zephyr/arch/xtensa/Kconfig"
osource "/home/edison/source/iomico-fund/deps/zephyr/arch/sparc/Kconfig"
osource "/home/edison/source/iomico-fund/deps/zephyr/arch/riscv/Kconfig"
osource "/home/edison/source/iomico-fund/deps/zephyr/arch/posix/Kconfig"
osource "/home/edison/source/iomico-fund/deps/zephyr/arch/mips/Kconfig"
osource "/home/edison/source/iomico-fund/deps/zephyr/arch/arm64/Kconfig"
osource "/home/edison/source/iomico-fund/deps/zephyr/arch/arm/Kconfig"
osource "/home/edison/source/iomico-fund/deps/zephyr/arch/arc/Kconfig"
```

## twister-out/native_sim_native/host/homework.unit.ring_buf/Kconfig/boards/Kconfig.defconfig
```kconfig
# Load Zephyr board defconfig descriptions.
osource "/home/edison/source/iomico-fund/deps/zephyr/boards/native/native_sim/Kconfig.defconfig"
```

## twister-out/native_sim_native/host/homework.unit.ring_buf/Kconfig/boards/Kconfig.sysbuild
```kconfig
# Load Sysbuild board Kconfig descriptions.
osource "/home/edison/source/iomico-fund/deps/zephyr/boards/native/native_sim/Kconfig.sysbuild"
```
